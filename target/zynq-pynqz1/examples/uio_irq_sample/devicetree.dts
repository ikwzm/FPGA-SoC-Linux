/dts-v1/;
/ {
	fragment@0 {
		target-path = "/amba/fpga-region0";
		#address-cells = <0x1>;
		#size-cells = <0x1>;

		__overlay__ {
			#address-cells = <0x1>;
			#size-cells = <0x1>;

			firmware-name = "pump_axi4.bin";

			pump-uio@43c10000 {
				compatible = "generic-uio";
				reg = <0x43c10000 0x1000>;
				interrupts = <0x0 0x1d 0x4>;
	                };

			pump-udmabuf4 {
				compatible  = "ikwzm,udmabuf-0.10.a";
				device-name = "udmabuf4";
				size = <0x00400000>;
	                };

			pump-udmabuf5 {
				compatible = "ikwzm,udmabuf-0.10.a";
				device-name = "udmabuf5";
				size = <0x00400000>;
			};
                };
	} ;
} ;
