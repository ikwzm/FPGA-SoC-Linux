/dts-v1/;
/{
	fragment@1 {
		target-path = "/amba/fpga-region0";
		#address-cells = <1>;
		#size-cells = <1>;
		__overlay__ {
			#address-cells = <1>;
			#size-cells = <1>;
			firmware-name = "zundoko_server.bin";
			zptty@43c10010 {
				compatible = "ikwzm,zptty-0.10.a";
				minor-number = <0>;
				reg = <0x43c10000 0x1000>;
				interrupts = <0x0 0x1d 0x4>;
			};
		};
	};
};

