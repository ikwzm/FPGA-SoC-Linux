/dts-v1/;
/{
	fragment@1 {
		target-path = "/soc/fpga-region0";
		#address-cells = <1>;
		#size-cells = <1>;
		__overlay__ {
			#address-cells = <1>;
			#size-cells = <1>;
			firmware-name = "fibonacci_server.rbf";
			zptty@ff202000 {
				compatible = "ikwzm,zptty-0.10.a";
				minor-number = <0>;
				reg = <0xff202000 0x1000>;
				interrupts = <0x0 0x28 0x4>;
	                };
		};
	};
};

